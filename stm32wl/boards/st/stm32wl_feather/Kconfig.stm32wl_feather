## stm32wl/boards/st/stm32wl_feather/Kconfig.stm32wl_feather
```kconfig
# Copyright (c) 2021 PureEngineering, LLC
# SPDX-License-Identifier: Apache-2.0

config BOARD_STM32WL_FEATHER
	select SOC_STM32WL55XX
```

## stm32wl/boards/st/stm32wl_feather/board.yml
```yaml
board:
  name: stm32wl_feather
  vendor: pure_engineering
  socs:
    - name: stm32wl55xx
```
